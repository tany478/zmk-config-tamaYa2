## config/boards/shields/tamaYa2/Kconfig.shield
```kconfig
config SHIELD_TAMAYA2_R
    def_bool $(shields_list_contains,tamaYa2_R)

config SHIELD_TAMAYA2_L
    def_bool $(shields_list_contains,tamaYa2_L)
```
